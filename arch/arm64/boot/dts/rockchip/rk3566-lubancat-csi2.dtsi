// SPDX-License-Identifier: (GPL-2.0+ OR MIT)
/*
 * Copyright (c) 2020 Rockchip Electronics Co., Ltd.
 *
 */

#include "rk3568-lubancat-csi2.dtsi"

&ov5648 {
	pwdn-gpios = <&gpio0 RK_PC3 GPIO_ACTIVE_HIGH>;
	reset-gpios = <&gpio0 RK_PC4 GPIO_ACTIVE_LOW>;
};

&ov8858 {
	pwdn-gpios = <&gpio0 RK_PC3 GPIO_ACTIVE_HIGH>;
	reset-gpios = <&gpio0 RK_PC4 GPIO_ACTIVE_HIGH>;
};

&ov13850 {
	pwdn-gpios = <&gpio0 RK_PC3 GPIO_ACTIVE_HIGH>;
	reset-gpios = <&gpio0 RK_PC4 GPIO_ACTIVE_HIGH>;
};
